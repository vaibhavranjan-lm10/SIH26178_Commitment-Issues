## edge-device/code_a_pod_firmware/app/tests/pipeline/testcase.yaml
```yaml
tests:
  prahari.pod.pipeline:
    platform_allow:
      - native_sim/native/64
    tags:
      - prahari
      - code_a
```

## edge-device/code_a_pod_firmware/app/tests/pod_position/testcase.yaml
```yaml
tests:
  prahari.pod.pod_position:
    platform_allow:
      - native_sim/native/64
    tags:
      - prahari
      - code_a
```

## edge-device/code_a_pod_firmware/app/tests/sampler/testcase.yaml
```yaml
tests:
  prahari.pod.sampler:
    platform_allow:
      - native_sim/native/64
    tags:
      - prahari
      - code_a
```

## edge-device/code_a_pod_firmware/app/tests/xdcr_select/testcase.yaml
```yaml
tests:
  prahari.pod.xdcr_select:
    platform_allow:
      - native_sim/native/64
    tags:
      - prahari
      - code_a
```

## edge-device/code_b_head_node/mcu/tests/bus_master/testcase.yaml
```yaml
tests:
  prahari.head_node.mcu.bus_master:
    platform_allow:
      - native_sim/native/64
    tags:
      - prahari
      - code_b
```

## edge-device/code_b_head_node/mcu/tests/rails_alert_rpc/testcase.yaml
```yaml
tests:
  prahari.head_node.mcu.rails_alert_rpc:
    platform_allow:
      - native_sim/native/64
    tags:
      - prahari
      - code_b
```

## edge-device/code_b_head_node/mcu/tests/supervisor/testcase.yaml
```yaml
tests:
  prahari.head_node.mcu.supervisor:
    platform_allow:
      - native_sim/native/64
    tags:
      - prahari
      - code_b
```

## edge-device/code_b_head_node/mcu/tests/tdma/testcase.yaml
```yaml
tests:
  prahari.head_node.mcu.tdma:
    platform_allow:
      - native_sim/native/64
    tags:
      - prahari
      - code_b
```
